## config/west.yml
```yaml
manifest:
  remotes:
    - name: zmkfirmware
      url-base: https://github.com/zmkfirmware
    - name: megamind
      url-base: https://github.com/megamind4089
    - name: nicell
      url-base: https://github.com/nicell
    - name: petejohanson
      url-base: https://github.com/petejohanson
    - name: careyk007
      url-base: https://github.com/careyk007
    - name: innovaker
      url-base: https://github.com/innovaker
    - name: okke-formsma
      url-base: https://github.com/okke-formsma
  projects:
    - name: zmk
      remote: zmkfirmware
      revision: v3.2.0+zmk-fixes
      #revision: main
      import: app/west.yml
              name-blocklist:
          - ci-tools
          - hal_altera
          - hal_cypress
          - hal_infineon
          - hal_microchip
          - hal_nxp
          - hal_openisa
          - hal_silabs
          - hal_xtensa
          - hal_st
          - hal_ti
          - loramac-node
          - mcuboot
          - mcumgr
          - net-tools
          - openthread
          - edtt
          - trusted-firmware-m
          - sof
  self:
    west-commands: scripts/west-commands.yml
  #self:
    #path: config
```
